## firmware/main/Kconfig.projbuild
```kconfig
menu "AI Pet"

config PET_WIFI_SSID
    string "WiFi SSID"
    default ""
    help
        先写死在配置里，以后再做配网页面。

config PET_WIFI_PASSWORD
    string "WiFi Password"
    default ""

config PET_WIFI2_SSID
    string "第二个 WiFi（手机热点，出门用）"
    default ""
    help
        开机扫一遍周围，家里的和这个哪个在就连哪个（都在时连家里的）；连着的不见了会重新扫、换另一个。
        连这个时直接走服务器中转（手机热点连不到家里的局域网）。热点要开 2.4GHz（很多手机默认 5GHz）。

config PET_WIFI2_PASSWORD
    string "第二个 WiFi 的密码"
    default ""

config PET_SERVER_URL
    string "PC 大脑地址（WebSocket，家里局域网）"
    default "ws://192.168.1.100:8600/ws"

config PET_SERVER_URL_REMOTE
    string "出门在外连大脑的地址（经服务器中转，wss）"
    default ""
    help
        局域网地址连不上（比如连着手机热点）就自动改连这个；空着就只连局域网。
        两个地址都要写明端口（wss 写 :443）：切换地址用 esp_websocket_client_set_uri，
        新地址不带端口时它会沿用上一个地址的端口（真机踩过：去连了 your-domain.example:8600）。

config PET_DEVICE_TOKEN
    string "设备密钥（和大脑 data/device_token.txt 一致）"
    default ""
    help
        经公网中转连大脑时必须带；局域网里不检查。

endmenu

# ---- 以下是小智语音模块用到的开关，名字保持和小智一致，代码就不用改 ----
menu "Audio (from xiaozhi)"

config USE_AUDIO_PROCESSOR
    bool "Enable AFE audio processing (AEC + VAD)"
    default y

config USE_DEVICE_AEC
    bool "Enable device-side AEC (lets you interrupt while it is talking)"
    default y
    depends on USE_AUDIO_PROCESSOR

config USE_AFE_WAKE_WORD
    bool "Wake word via AFE (WakeNet)"
    default y

config USE_SERVER_AEC
    bool
    default n

config USE_ESP_WAKE_WORD
    bool
    default n

config USE_CUSTOM_WAKE_WORD
    bool
    default n

config CUSTOM_WAKE_WORD
    string "自定义唤醒词（拼音，音节之间空格）"
    default "zhu mi zhu mi"
    help
        模型分区里有中文 MultiNet 模型（ESP Speech Recognition -> mn7_cn）时用它当唤醒词，代替“你好小智”。

config CUSTOM_WAKE_WORD_DISPLAY
    string "自定义唤醒词（中文，日志里显示）"
    default "猪咪猪咪"

config CUSTOM_WAKE_WORD_THRESHOLD
    int "唤醒灵敏度阈值（百分比，越低越容易唤醒、也越容易误触发）"
    default 20
    range 5 90

config SEND_WAKE_WORD_DATA
    bool
    default n

config USE_AUDIO_DEBUGGER
    bool "Enable audio debugger (UDP)"
    default n

config AUDIO_DEBUG_UDP_SERVER
    string "Audio debugger UDP server"
    default "192.168.1.100:8000"
    depends on USE_AUDIO_DEBUGGER

endmenu
```

## firmware/sdkconfig.defaults
```kconfig
# 立创实战派 ESP32-S3（N16R8）。大部分取自小智固件对 ESP32-S3 的默认配置。

# ---- 芯片、Flash、PSRAM ----
CONFIG_IDF_TARGET="esp32s3"
CONFIG_ESPTOOLPY_FLASHSIZE_16MB=y
CONFIG_ESPTOOLPY_FLASHMODE_QIO=y
CONFIG_PARTITION_TABLE_CUSTOM=y
CONFIG_PARTITION_TABLE_CUSTOM_FILENAME="partitions.csv"
CONFIG_ESP_DEFAULT_CPU_FREQ_MHZ_240=y
CONFIG_SPIRAM=y
CONFIG_SPIRAM_MODE_OCT=y
CONFIG_SPIRAM_SPEED_80M=y
CONFIG_SPIRAM_MALLOC_ALWAYSINTERNAL=1024
CONFIG_SPIRAM_MALLOC_RESERVE_INTERNAL=102400
CONFIG_SPIRAM_MEMTEST=n
CONFIG_ESP32S3_INSTRUCTION_CACHE_32KB=y
CONFIG_ESP32S3_DATA_CACHE_LINE_64B=y

# ---- 编译 ----
CONFIG_COMPILER_OPTIMIZATION_PERF=y
CONFIG_COMPILER_CXX_EXCEPTIONS=n
CONFIG_COMPILER_CXX_RTTI=n
CONFIG_ESP_MAIN_TASK_STACK_SIZE=8192
CONFIG_ESP_TASK_WDT_TIMEOUT_S=10
CONFIG_ESP_SYSTEM_EVENT_TASK_STACK_SIZE=4096

# ---- WiFi / 网络（取自小智，省内存）----
CONFIG_ESP_WIFI_IRAM_OPT=n
CONFIG_ESP_WIFI_RX_IRAM_OPT=n
CONFIG_ESP_WIFI_DYNAMIC_RX_MGMT_BUFFER=y
CONFIG_ESP_WIFI_STATIC_RX_BUFFER_NUM=3
CONFIG_ESP_WIFI_DYNAMIC_RX_BUFFER_NUM=6
CONFIG_ESP_WIFI_RX_BA_WIN=3
CONFIG_LWIP_TCPIP_RECVMBOX_SIZE=16
CONFIG_MBEDTLS_EXTERNAL_MEM_ALLOC=y
CONFIG_MBEDTLS_DYNAMIC_BUFFER=y

# ---- 语音（ESP-SR）：WebRTC 的 VAD/降噪不需要模型；唤醒词先用“你好小智”，以后可换 ----
CONFIG_SR_VADN_WEBRTC=y
CONFIG_SR_NSN_WEBRTC=y
CONFIG_SR_WN_WN9_NIHAOXIAOZHI_TTS=y
CONFIG_SR_MN_CN_NONE=y
CONFIG_SR_MN_EN_NONE=y
CONFIG_CODEC_I2C_BACKWARD_COMPATIBLE=n
```
